## ESP32-V2/sdkconfig.defaults
```kconfig
CONFIG_ESPTOOLPY_FLASHSIZE_4MB=y
CONFIG_PARTITION_TABLE_SINGLE_APP=y
CONFIG_ESP_WIFI_ENABLED=y
CONFIG_ESP_WIFI_STA_DISCONNECTED_PM_ENABLE=y
CONFIG_LWIP_LOCAL_HOSTNAME="makerspace-c6"
CONFIG_NEWLIB_STDOUT_LINE_ENDING_CRLF=y
CONFIG_COMPILER_OPTIMIZATION_SIZE=y
CONFIG_BOOTLOADER_LOG_LEVEL_NONE=y
CONFIG_BOOTLOADER_LOG_LEVEL=0
CONFIG_LOG_DEFAULT_LEVEL_NONE=y
CONFIG_LOG_DEFAULT_LEVEL=0
CONFIG_ESP_HTTP_CLIENT_ENABLE_HTTPS=n
CONFIG_ESP_TLS_USED=n
CONFIG_MBEDTLS_CERTIFICATE_BUNDLE=n
CONFIG_ESP_NETIF_TCPIP_LWIP=y
CONFIG_LWIP_DHCP=y
CONFIG_LWIP_DNS=y
CONFIG_LWIP_TCP=y
CONFIG_FATFS_VOLUME_COUNT=1
CONFIG_SPI_FLASH_ROM_DRIVER_PATCH=n
CONFIG_ESPTOOLPY_FLASHMODE_DIO=y
CONFIG_ESPTOOLPY_FLASHFREQ_80M=y
```
